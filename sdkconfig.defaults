## sdkconfig.defaults
```kconfig
# ESP32-S3 target configuration
# Module: ESP32-S3-WROOM-1-N16R8 (16MB Flash + 8MB PSRAM)

CONFIG_IDF_TARGET="esp32s3"

# Flash configuration (16MB)
CONFIG_ESPTOOLPY_FLASHSIZE_16MB=y
CONFIG_ESPTOOLPY_FLASHSIZE="16MB"

# PSRAM configuration (8MB Octal PSRAM)
CONFIG_ESP32S3_SPIRAM_SUPPORT=y
CONFIG_SPIRAM_MODE_OCT=y
CONFIG_SPIRAM_SPEED_80M=y
CONFIG_SPIRAM_USE_MALLOC=y
CONFIG_SPIRAM_MALLOC_ALWAYSINTERNAL=16384
CONFIG_SPIRAM_TRY_ALLOCATE_WIFI_LWIP=y

# Increase main task stack size when PSRAM enabled
CONFIG_ESP_MAIN_TASK_STACK_SIZE=8192

# TCP buffer must be large enough to hold a full JPEG frame in flight
# Default 5760 (4×MSS) causes httpd_ws_send_frame_async to block when buffer fills
CONFIG_LWIP_TCP_SND_BUF_DEFAULT=32768
CONFIG_LWIP_TCP_WND_DEFAULT=32768

# HTTP Server configuration
CONFIG_HTTPD_MAX_REQ_HDR_LEN=1024
```
